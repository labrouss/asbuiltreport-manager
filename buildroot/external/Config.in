## buildroot/external/Config.in
```kconfig
menu "AsBuiltReport Manager"
    source "$BR2_EXTERNAL_ASBUILTREPORT_MANAGER_PATH/package/asbuiltreport-manager/Config.in"

source "$BR2_EXTERNAL_ASBUILTREPORT_MANAGER_PATH/package/vmware-rpctool/Config.in"
endmenu
```

## buildroot/external/configs/asbuiltreport_manager_defconfig
```kconfig
# =============================================================================
# buildroot/external/configs/asbuiltreport_manager_defconfig
#
# Buildroot 2024.02.x — AsBuiltReport Manager OVA
#
# All symbols validated against the san-manager reference defconfig which
# is confirmed working on Buildroot 2024.02.9.
#
# Key decisions matching san-manager exactly:
#   - BR2_TOOLCHAIN_BUILDROOT_MUSL=y  (explicit musl selection)
#   - BR2_GCC_VERSION_13_X + BR2_BINUTILS_VERSION_2_41_X (pinned toolchain)
#   - BR2_LINUX_KERNEL_CUSTOM_VERSION pinned to 6.6.63 (same as san-manager)
#   - BR2_LINUX_KERNEL_CONFIG_FRAGMENT_FILES for Docker kernel options
#   - BR2_TARGET_GRUB2_X86_64_EFI only — no BIOS/legacy (avoids BR2_LEGACY)
#   - BR2_PACKAGE_DOCKER_COMPOSE=y (Buildroot 2024.02 has the compose package)
#   - BR2_PACKAGE_OPEN_VM_TOOLS=y (not OPENVMTOOLS)
#   - BR2_PACKAGE_OPENSSH=y (not dropbear)
#   - BR2_INIT_SYSTEMD is NOT set — san-manager uses busybox init
#     (systemd pulls in a massive dependency tree; use S-script style init)
#   - Rootfs size 38G for Docker image storage
# =============================================================================

# ── Architecture ──────────────────────────────────────────────────────────────
BR2_x86_64=y
BR2_TARGET_OPTIMIZATION="-O2 -pipe -march=x86-64-v2"

# ── Toolchain ────────────────────────────────────────────────────────────────
BR2_TOOLCHAIN_BUILDROOT_MUSL=y
BR2_TOOLCHAIN_BUILDROOT_CXX=y
BR2_GCC_VERSION_13_X=y
BR2_BINUTILS_VERSION_2_41_X=y

# ── System ────────────────────────────────────────────────────────────────────
BR2_SYSTEM_DHCP="eth0"
BR2_TARGET_GENERIC_HOSTNAME="asbuiltreport-manager"
BR2_TARGET_GENERIC_ISSUE="AsBuiltReport Manager Appliance"
BR2_TARGET_TZ_INFO=y
BR2_TARGET_LOCALTIME="UTC"

# ── Kernel ────────────────────────────────────────────────────────────────────
BR2_LINUX_KERNEL=y
BR2_LINUX_KERNEL_CUSTOM_VERSION=y
BR2_LINUX_KERNEL_CUSTOM_VERSION_VALUE="6.6.63"
BR2_LINUX_KERNEL_USE_DEFCONFIG=y
BR2_LINUX_KERNEL_DEFCONFIG="x86_64"
BR2_LINUX_KERNEL_CONFIG_FRAGMENT_FILES="$(BR2_EXTERNAL_ASBUILTREPORT_MANAGER_PATH)/board/asbuiltreport-manager/linux-docker.fragment"
BR2_LINUX_KERNEL_NEEDS_HOST_OPENSSL=y

# ── Bootloader — EFI only (avoids BR2_TARGET_GRUB2_HAS_LEGACY_BOOT legacy symbol)
BR2_TARGET_GRUB2=y
BR2_TARGET_GRUB2_X86_64_EFI=y

# ── Root filesystem ───────────────────────────────────────────────────────────
BR2_TARGET_ROOTFS_EXT2=y
BR2_TARGET_ROOTFS_EXT2_4=y
BR2_TARGET_ROOTFS_EXT2_SIZE="8G"
BR2_ROOTFS_OVERLAY="$(BR2_EXTERNAL_ASBUILTREPORT_MANAGER_PATH)/rootfs_overlay"
BR2_ROOTFS_POST_BUILD_SCRIPT="$(BR2_EXTERNAL_ASBUILTREPORT_MANAGER_PATH)/board/asbuiltreport-manager/post-build.sh"
BR2_ROOTFS_POST_IMAGE_SCRIPT="$(BR2_EXTERNAL_ASBUILTREPORT_MANAGER_PATH)/board/asbuiltreport-manager/post-image.sh"

# ── Host tools ────────────────────────────────────────────────────────────────
BR2_PACKAGE_HOST_GENIMAGE=y
BR2_PACKAGE_HOST_DOSFSTOOLS=y
BR2_PACKAGE_HOST_MTOOLS=y
BR2_PACKAGE_HOST_PARTED=y

# ── Core utilities ────────────────────────────────────────────────────────────
BR2_PACKAGE_BUSYBOX=y
BR2_PACKAGE_BASH=y
BR2_PACKAGE_CA_CERTIFICATES=y
BR2_PACKAGE_OPENSSL=y
BR2_PACKAGE_OPENSSH=y
BR2_PACKAGE_LIBCURL=y
BR2_PACKAGE_LIBCURL_CURL=y

# ── Filesystem & disk tools ───────────────────────────────────────────────────
BR2_PACKAGE_E2FSPROGS=y
BR2_PACKAGE_E2FSPROGS_RESIZE2FS=y
BR2_PACKAGE_PARTED=y
BR2_PACKAGE_GDISK=y
BR2_PACKAGE_UTIL_LINUX=y
BR2_PACKAGE_UTIL_LINUX_MOUNT=y

# ── Networking ────────────────────────────────────────────────────────────────
BR2_PACKAGE_IPTABLES=y
BR2_PACKAGE_IPROUTE2=y
BR2_PACKAGE_NFTABLES=y
BR2_PACKAGE_BRIDGE_UTILS=y

# ── Container runtime ────────────────────────────────────────────────────────
BR2_PACKAGE_DOCKER_ENGINE=y
BR2_PACKAGE_DOCKER_CLI=y
BR2_PACKAGE_DOCKER_COMPOSE=y

# ── TUI management console ────────────────────────────────────────────────────
BR2_PACKAGE_NEWT=y
BR2_PACKAGE_DIALOG=y

# ── Time sync ────────────────────────────────────────────────────────────────
BR2_PACKAGE_CHRONY=y

# ── Ops tooling ──────────────────────────────────────────────────────────────
BR2_PACKAGE_HTOP=y
BR2_PACKAGE_LESS=y
BR2_PACKAGE_VIM_TINY=y
BR2_PACKAGE_JQ=y

# ── Build cache ──────────────────────────────────────────────────────────────
BR2_CCACHE=y

# ── VMware guest tools ────────────────────────────────────────────────────────
BR2_PACKAGE_OPEN_VM_TOOLS=y
BR2_PACKAGE_OPEN_VM_TOOLS_SCRIPTS=y
BR2_PACKAGE_LIBGLIB2=y
BR2_PACKAGE_UTIL_LINUX_LIBBLKID=y
BR2_PACKAGE_UTIL_LINUX_LIBUUID=y

# ── External tree package ────────────────────────────────────────────────────
BR2_PACKAGE_ASBUILTREPORT_MANAGER=y
```

## buildroot/external/package/asbuiltreport-manager/Config.in
```kconfig
config BR2_PACKAGE_ASBUILTREPORT_MANAGER
    bool "asbuiltreport-manager"
    default y
    help
      Installs the AsBuiltReport Manager Docker Compose application,
      pre-loaded Docker images, systemd service, management console,
      and first-boot configuration scripts.
```

## buildroot/external/package/vmware-rpctool/Config.in
```kconfig
config BR2_PACKAGE_VMWARE_RPCTOOL
	bool "vmware-rpctool"
	depends on BR2_x86_64
	help
	  Minimal VMware GuestInfo reader using the VMware backdoor I/O port.
	  Replaces open-vm-tools for musl-based builds.
	  Reads guestinfo properties set via OVF/vApp configuration.
```
